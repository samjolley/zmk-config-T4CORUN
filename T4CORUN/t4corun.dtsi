#include <behaviors.dtsi>

#include "../T4CORUN/homerowmods.dtsi"
#include "../T4CORUN/macros.dtsi"
#include "../T4CORUN/mouse.dtsi"
#include "../T4CORUN/tapdances.dtsi"

#include <dt-bindings/zmk/keys.h>
#include <dt-bindings/zmk/bt.h>
#include <dt-bindings/zmk/outputs.h>
#include "t4corun.h"

&lt {
    flavor = "tap-preferred";
    tapping-term-ms = <TAPPING_TERM>;
};

&mt {
    flavor = "tap-preferred";
    tapping-term-ms = <TAPPING_TERM>;
};